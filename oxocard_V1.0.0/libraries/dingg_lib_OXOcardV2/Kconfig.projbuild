## oxocard_V1.0.0/libraries/dingg_lib_OXOcardV2/Kconfig.projbuild
```kconfig
menu "OXOcard LIB configuration"

config OTA_HOSTNAME
	string "OTA hostname"
	default "build.oxocard.ch"
	help
		The hostname of the backend to use.

config OTA_PATH_PREFIX
	string "OTA path prefix"
	default "/v1/oxocard2"
	help
		The path prefix to use.

config OTA_PORT
	int "OTA port"
	default 443
	help
		Port to use. SSL defaults to 443.

endmenu
```

## oxocard_V1.0.1/libraries/dingg_lib_OXOcardV2/Kconfig.projbuild
```kconfig
menu "OXOcard LIB configuration"

config SLEEP_BUTTON_BYTE
	int "Sleep button byte"
	default 63
	help
		User either 0 (no buttons) or 63 (0b00111111 - all buttons can be used to wake up).

endmenu
```
